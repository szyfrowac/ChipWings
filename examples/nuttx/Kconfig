## examples/nuttx/cw_rpmsg_echo/Kconfig
```kconfig
config CW_EXAMPLE_RPMSG_ECHO
	tristate "cw_rpmsg_echo: RPMsg echo endpoint cw-echo for Linux"
	default n
	depends on RPTUN
```

## examples/nuttx/cw_rpmsg_imu/Kconfig
```kconfig
config CW_EXAMPLE_RPMSG_IMU
	tristate "cw_rpmsg_imu: simulated IMU stream to Linux over RPMsg (cw-imu)"
	default n
	depends on RPTUN
```

## examples/nuttx/cw_threads/Kconfig
```kconfig
config CW_EXAMPLE_THREADS
	tristate "cw_threads: pthreads, mutex, semaphore and message queue test"
	default n
```

## examples/nuttx/cw_timer/Kconfig
```kconfig
config CW_EXAMPLE_TIMER
	tristate "cw_timer: periodic wake-up jitter test"
	default n
```

## sw/br2-chipwings/package/chipwings-examples/Config.in
```kconfig
config BR2_PACKAGE_CHIPWINGS_EXAMPLES
	bool "chipwings-examples"
	depends on BR2_TOOLCHAIN_HAS_THREADS
	help
	  Linux-side test programs from the Chipwings examples/ folder:
	  hartcheck, rpmsg_ping, rpmsg_echo, rpmsg_imu (installed in
	  /usr/bin). The rpmsg_* programs talk to NuttX on hart 1.
```

## sw/chipwings-apps/cwinit/Kconfig
```kconfig
config CHIPWINGS_CWINIT
	tristate "cwinit: Chipwings start-up (RPMsg link to Linux, then NSH)"
	default n
	depends on SYSTEM_NSH
	---help---
		Start-up entry point for the flight-control core. Set
		CONFIG_INIT_ENTRYPOINT="cwinit_main". It starts the remoteproc
		tunnel to Linux (RPTUNIOC_START on /dev/rptun/<cpuname>), which
		fills in the RPMsg resource table before Linux attaches, and then
		runs NSH as usual.

if CHIPWINGS_CWINIT

config CHIPWINGS_CWINIT_RPTUN
	string "rptun device to start"
	default "/dev/rptun/mpfsihc"
	depends on RPTUN

endif
```
